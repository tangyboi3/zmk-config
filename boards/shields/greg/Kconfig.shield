## boards/shields/greg/Kconfig.shield
```kconfig
config SHIELD_GREG_LEFT
    def_bool $(shields_list_contains,greg_left)

config SHIELD_GREG_RIGHT
    def_bool $(shields_list_contains,greg_right)
```

## config/west.yml
```yaml
manifest:
  remotes:
    - name: zmkfirmware
      url-base: https://github.com/zmkfirmware
    - name: tangyboi3
      url-base: https://github.com/tangyboi3
    # Additional modules containing boards/shields/custom code can be listed here as well
    # See https://docs.zephyrproject.org/3.2.0/develop/west/manifest.html#projects
  projects:
    - name: zmk
      remote: zmkfirmware
      revision: main
      import: app/west.yml
    - name: zmk-keyboard-greg
      remote: tangyboi3
      revision: main
  self:
    path: config
```
